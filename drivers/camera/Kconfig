## drivers/camera/Kconfig
```kconfig
# Kconfig - Display drivers

#
# Copyright (c) 2017 Intel Corporation
#
# SPDX-License-Identifier: Apache-2.0
#

menuconfig CAMERA
	bool "Camera Drivers"
	default y
	help
	  Enable camera drivers

if CAMERA

module = CAMERA
module-str = camera

config CAMERA_DEV_NAME
	string "Device Name of Camera Device"
	default "camera_0"
	help
		This option specifies the name of camera device

source "drivers/camera/Kconfig.csi"

endif
```

## drivers/camera/Kconfig.csi
```kconfig
#
# Copyright (c) 2019, NXP
#
# SPDX-License-Identifier: Apache-2.0
#

menuconfig CMOS_IMAGE_SENSOR_INTERFACE
	bool "MCUX cmos sensor driver"
	help
	  Enable support for mcux cmos sensor driver.
```
